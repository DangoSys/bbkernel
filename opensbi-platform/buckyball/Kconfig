## opensbi-platform/buckyball/Kconfig
```kconfig
# SPDX-License-Identifier: BSD-2-Clause

config PLATFORM_BUCKYBALL
	bool
	select FDT
	select IPI_MSWI
	select IRQCHIP_PLIC
	select TIMER_MTIMER
	default y
```
